## configs/spotify_carthing_probe_defconfig
```kconfig
CONFIG_ARM=y
CONFIG_SYS_BOARD="spotify-carthing"
CONFIG_SYS_CONFIG_NAME="spotify-carthing"
CONFIG_ARCH_MESON=y
CONFIG_TEXT_BASE=0x01000000
CONFIG_SYS_MALLOC_LEN=0x8000000
CONFIG_NR_DRAM_BANKS=1
CONFIG_HAS_CUSTOM_SYS_INIT_SP_ADDR=y
CONFIG_CUSTOM_SYS_INIT_SP_ADDR=0x20000000
CONFIG_ENV_SIZE=0x10000
CONFIG_ENV_IS_IN_FAT=y
CONFIG_ENV_FAT_INTERFACE="mmc"
CONFIG_ENV_FAT_DEVICE_AND_PART="0#env"
CONFIG_ENV_FAT_FILE="uboot.env"
CONFIG_FAT_WRITE=y
CONFIG_SHA256=y
CONFIG_ENV_OVERWRITE=y
CONFIG_DM_GPIO=y
CONFIG_DEFAULT_DEVICE_TREE="amlogic/meson-g12a-spotify-carthing"
CONFIG_DM_RESET=y
CONFIG_MESON_G12A=y
CONFIG_SYS_LOAD_ADDR=0x1000000
CONFIG_DEBUG_UART_BASE=0xff803000
CONFIG_DEBUG_UART_CLOCK=24000000
CONFIG_IDENT_STRING=" spotify-carthing"
CONFIG_DEBUG_UART=y
# CONFIG_EFI_LOADER is not set
# CONFIG_BOOTSTD is not set
CONFIG_BOOTDELAY=3
CONFIG_LOGLEVEL=7
# CONFIG_DISPLAY_CPUINFO is not set
CONFIG_MISC_INIT_R=y
CONFIG_SYS_MAXARGS=32
CONFIG_CMD_GPIO=y
CONFIG_CMD_GPT=y
CONFIG_CMD_I2C=y
# CONFIG_CMD_LOADS is not set
CONFIG_CMD_ADC=y
CONFIG_CMD_MMC=y
CONFIG_CMD_POWEROFF=y
CONFIG_CMD_USB=y
CONFIG_CMD_USB_MASS_STORAGE=y
CONFIG_OF_CONTROL=y
CONFIG_ENV_RELOC_GD_ENV_ADDR=y
# CONFIG_NET is not set
CONFIG_BUTTON=y
CONFIG_BUTTON_GPIO=y
CONFIG_USB_FUNCTION_FASTBOOT=y
CONFIG_FASTBOOT_BUF_ADDR=0x6000000
CONFIG_FASTBOOT_FLASH=y
CONFIG_FASTBOOT_FLASH_MMC_DEV=0
CONFIG_FASTBOOT_CMD_OEM_FORMAT=y
CONFIG_FASTBOOT_OEM_RUN=y
CONFIG_FASTBOOT_CMD_OEM_CONSOLE=y
CONFIG_FASTBOOT_CMD_OEM_MASKROM=y
CONFIG_FASTBOOT_CMD_FETCH=y
CONFIG_FASTBOOT_MMC_BOOT_SUPPORT=y
CONFIG_FASTBOOT_MMC_USER_SUPPORT=y
CONFIG_CONSOLE_RECORD=y
CONFIG_DM_I2C=y
CONFIG_SYS_I2C_MESON=y
# CONFIG_INPUT is not set
CONFIG_MMC_MESON_GX=y
CONFIG_ADC=y
CONFIG_SARADC_MESON=y
CONFIG_MESON_G12A_USB_PHY=y
CONFIG_PINCTRL=y
CONFIG_PINCTRL_MESON_G12A=y
CONFIG_POWER_DOMAIN=y
CONFIG_MESON_EE_POWER_DOMAIN=y
CONFIG_DM_REGULATOR=y
CONFIG_DM_REGULATOR_FIXED=y
CONFIG_DM_PWM=y
CONFIG_PWM_MESON=y
CONFIG_DEBUG_UART_SKIP_INIT=y
CONFIG_MESON_SERIAL=y
CONFIG_USB=y
CONFIG_DM_USB_GADGET=y
CONFIG_USB_XHCI_HCD=y
CONFIG_USB_XHCI_DWC3=y
CONFIG_USB_DWC3=y
# CONFIG_USB_DWC3_GADGET is not set
CONFIG_USB_DWC3_MESON_G12A=y
CONFIG_USB_GADGET=y
CONFIG_USB_GADGET_MANUFACTURER="Thing Labs"
CONFIG_USB_GADGET_VENDOR_NUM=0x18d1
CONFIG_USB_GADGET_PRODUCT_NUM=0xfada
CONFIG_USB_GADGET_DWC2_OTG=y
CONFIG_USB_GADGET_DWC2_OTG_PHY_BUS_WIDTH_8=y
CONFIG_VIDEO=y
CONFIG_VIDEO_FONT_8X16=y
# CONFIG_VIDEO_FONT_16X32 is not set
CONFIG_CONSOLE_ROTATION=y
CONFIG_SYS_WHITE_ON_BLACK=y
CONFIG_VIDEO_LCD_ST7701S_CARTHING=y
CONFIG_VIDEO_MESON=y
# CONFIG_VIDEO_MESON_DW_HDMI is not set
CONFIG_VIDEO_MESON_DW_MIPI_DSI=y
CONFIG_BMP_16BPP=y
CONFIG_BMP_24BPP=y
CONFIG_BMP_32BPP=y
CONFIG_CARTHING_DEBUG_CONSOLE=y
CONFIG_CARTHING_AUTOPROBE=y
CONFIG_PRE_CONSOLE_BUFFER=y
CONFIG_PRE_CON_BUF_ADDR=0x0f000000
CONFIG_PRE_CON_BUF_SZ=32768
CONFIG_DISPLAY_BOARDINFO_LATE=y
CONFIG_MMC_SPEED_MODE_SET=y
```

## drivers/video/meson/Kconfig
```kconfig
# SPDX-License-Identifier: GPL-2.0+
#
# Copyright (C) 2018 BayLibre, SAS
#
# Author: Neil Armstrong <narmstrong@baylibre.com>

config VIDEO_MESON
	bool "Enable Amlogic Meson video support"
	depends on VIDEO && ARCH_MESON
	select DISPLAY
	imply VIDEO_DAMAGE
	help
	  Enable Amlogic Meson Video Processing Unit video support.

config VIDEO_MESON_DW_HDMI
	bool "Amlogic Meson DesignWare HDMI controller support"
	depends on VIDEO_MESON
	default y
	help
	  Build the Synopsys DesignWare HDMI controller glue
	  (drivers/video/meson/meson_dw_hdmi.c plus the shared
	  drivers/video/dw_hdmi.c core). Disable on boards that have no
	  HDMI output (e.g. DSI-only displays like the Spotify Car Thing)
	  to save ~30 KiB of binary size.

config VIDEO_MESON_DW_MIPI_DSI
	bool "Amlogic Meson G12A DesignWare MIPI DSI host wrapper"
	depends on VIDEO_MESON
	select VIDEO_BRIDGE
	select VIDEO_MIPI_DSI
	select VIDEO_DW_MIPI_DSI
	select PHY
	select MESON_AXG_MIPI_DPHY
	select MESON_AXG_MIPI_PCIE_ANALOG_PHY
	help
	  Amlogic G12A glue for the Synopsys DesignWare MIPI DSI host. The
	  DWC IP is driven by drivers/video/dw_mipi_dsi.c; this driver owns
	  the top-level wrapper registers, reset, and clock setup that sit
	  in front of the DWC core. Pair with an MIPI DSI panel driver
	  (e.g. VIDEO_LCD_ST7701S_CARTHING).
```
